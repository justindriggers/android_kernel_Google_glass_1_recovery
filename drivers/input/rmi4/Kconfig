## drivers/input/rmi4/Kconfig
```kconfig
config TOUCHPAD_SYNAPTICS_RMI4_I2C
  tristate "Synaptics RMI4 I2C touchpads"
  depends on I2C && RMI4_DEV
  help
    Say Y here if you have a Synaptics RMI4 I2C touchpad connected to
    your system. This enables support for Synaptics RMI4 over I2C based
    touchpads.

    If unsure, say N.
```

## drivers/input/touchpad/Kconfig
```kconfig
#
# Touchscreen driver configuration
#
menuconfig INPUT_TOUCHPAD
	bool "Touchpads"
	help
	  Say Y here, and a list of supported touchpads will be displayed.
	  This option doesn't affect the kernel.

	  If unsure, say Y.

if INPUT_TOUCHPAD

config INPUT_TOUCHPAD_FTK
	tristate "STMicroelectronics FingerTipK touchpad"
	depends on I2C && INPUT
	help
	  Say Y here if you have a STMicroelectronics FingerTipK touchpad i2c device.  If unsure, say N.
    

endif
```
